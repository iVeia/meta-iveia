## conf/machine/atlas-ii-z8p-hp.conf
```bitbake
#@TYPE: Machine
#@NAME: atlas-ii-z8p-hp
#@DESCRIPTION: Machine support for iVeia Atlas-II Z8p HP SoM.

require atlas-z8.inc
```

## conf/machine/atlas-iii-z8-t2.conf
```bitbake
#@TYPE: Machine
#@NAME: atlas-iii-z8-t2
#@DESCRIPTION: Machine support for iVeia Atlas-III Z8 T2 SoM.

require atlas-z8.inc
```

## conf/machine/atlas-iii-z8-var04.conf
```bitbake
#@TYPE: Machine
#@NAME: atlas-iii-z8-var04
#@DESCRIPTION: Machine support for iVeia Atlas-III Z8 Var 04 SoM.

require atlas-z8.inc
```

## conf/machine/atlas-iii-z8-var10.conf
```bitbake
#@TYPE: Machine
#@NAME: atlas-iii-z8-var10
#@DESCRIPTION: Machine support for iVeia Atlas-III Z8 Var 10 SoM.

require atlas-z8.inc
```

## conf/machine/atlas-iii-z8.conf
```bitbake
#@TYPE: Machine
#@NAME: atlas-iii-z8
#@DESCRIPTION: Machine support for iVeia Atlas-III Z8 SoM.

require atlas-z8.inc
```

## conf/machine/atlas-z7.conf
```bitbake
#@TYPE: Machine
#@NAME: atlas-z7
#@DESCRIPTION: Generic machine for building SDK on any iVeia Zynq7000-based SoM.

require atlas-z7.inc
```

## conf/machine/atlas-z8.conf
```bitbake
#@TYPE: Machine
#@NAME: atlas-z8
#@DESCRIPTION: Generic machine for building SDK on any iVeia ZynqMP-based SoM.

require atlas-z8.inc
```

## conf/machine/helios-z7-pcie.conf
```bitbake
#@TYPE: Machine
#@NAME: helios-z7-pcie
#@DESCRIPTION: Machine support for iVeia Helios Z7 PCIe SoM.

require atlas-z7.inc
```

## conf/machine/helios-z8.conf
```bitbake
#@TYPE: Machine
#@NAME: helios-z8
#@DESCRIPTION: Machine support for iVeia Helios Z8 SoM.

require helios-z8.inc
```

## recipes-bsp/u-boot/files/Kconfig
```kconfig
config EEPROM_IPMI_ALTERNATE_FOR_00130
	bool "Alternate EEPROM format for iVeia board PN 00130"
	default n
```

## recipes-kernel/iv-events/src/Kconfig
```kconfig
config IVEIA_EVENTS
	tristate "iVeia's Events driver"
	depends on IVEIA_TITANV5 || IVEIA_TITAN_PPCX || MACH_IV_ATLAS_I_LPE || MACH_IV_ATLAS_I_Z7E
	default n
	---help---
	  iVeia's Events driver
	  
	  This driver provides support for interrupt driven event notification.
```

## recipes-kernel/linux/files/Documentation/devicetree/bindings/net/mdio-i2c-gen.txt
```
Generic MDIO bus over I2C

Required properties :
- compatible : Must be "mdio-i2c-gen"
- reg : I2C address of the device
- #address-cells : Must be <1>;
- #size-cells : Must be <0>;

Must have exactly one child node that is a standard Ethernet PHY device node as
described in Documentation/devicetree/bindings/net/phy.txt.  The child node's
"reg" property is the PHY address, and must be exactly 0x40 less than the I2C
address of the parent MDIO node.  PHY addresses of 0x10 and 0x11 are not
allowed, because of driver library limitations for SFP compatibility.

Example :

/* Associated Ethernet node */
&gem3 {
    status = "okay";
    phy-handle =  <&phy0>;
};

/* Parent I2C bus of MDIO I2C node */
&i2c0 {
    mdio@40 {
        compatible = "mdio-i2c-gen";
        reg = <0x40>;
        #address-cells = <1>;
        #size-cells = <0>;

        phy0: phy@0 {
            reg = <0>;
        };
    };
};
```
