## conf/machine/00049.conf
```bitbake
#@TYPE: Machine
#@NAME: 00049
#@DESCRIPTION: Machine support for iVeia Atlas-I Z7e SoM.

require atlas-z7.inc
```

## conf/machine/00068.conf
```bitbake
#@TYPE: Machine
#@NAME: 00068
#@DESCRIPTION: Machine support for iVeia Atlas-II Z7x SoM.

require atlas-z7.inc
```

## conf/machine/00090.conf
```bitbake
#@TYPE: Machine
#@NAME: 00090
#@DESCRIPTION: Machine support for iVeia Atlas-II Z8 SoM.

require atlas-z8.inc
```

## conf/machine/00102.conf
```bitbake
#@TYPE: Machine
#@NAME: 00102
#@DESCRIPTION: Machine support for iVeia Helios Z7 PCIe SoM.

require helios-z7.inc
```

## conf/machine/00104-fs001.conf
```bitbake
#@TYPE: Machine
#@NAME: 00104-fs001
#@DESCRIPTION: Machine support for iVeia Atlas-III Z8 SoM Speed -2.

require atlas-z8.inc

MACHINEOVERRIDES =. "00104"
```

## conf/machine/00104-fs002.conf
```bitbake
#@TYPE: Machine
#@NAME: 00104
#@DESCRIPTION: Machine support for iVeia Atlas-III Z8 SoM Speed -1, PS 8GB.

require atlas-z8.inc

MACHINEOVERRIDES =. "00104"
```

## conf/machine/00104.conf
```bitbake
#@TYPE: Machine
#@NAME: 00104
#@DESCRIPTION: Machine support for iVeia Atlas-III Z8 SoM, any variant.

require atlas-z8.inc
```

## conf/machine/00108.conf
```bitbake
#@TYPE: Machine
#@NAME: 00108
#@DESCRIPTION: Machine support for iVeia Atlas-I Z8 SoM.

require atlas-z8.inc
```

## conf/machine/00114.conf
```bitbake
#@TYPE: Machine
#@NAME: 00114
#@DESCRIPTION: Machine support for iVeia Atlas-III Z8e SoM.

require atlas-z8.inc
```

## conf/machine/00122.conf
```bitbake
#@TYPE: Machine
#@NAME: 00122
#@DESCRIPTION: Machine support for iVeia Atlas-II Z8 HP SoM.

require atlas-z8.inc
```

## conf/machine/00126.conf
```bitbake
#@TYPE: Machine
#@NAME: 00126
#@DESCRIPTION: Machine support for iVeia Helios Z8 SoM.

require helios-z8.inc
```

## conf/machine/00127.conf
```bitbake
#@TYPE: Machine
#@NAME: 00127
#@DESCRIPTION: Machine support for iVeia Atlas-II Z8ev SoM.

require atlas-z8.inc
```

## conf/machine/00130.conf
```bitbake
#@TYPE: Machine
#@NAME: 00130
#@DESCRIPTION: Machine support for iVeia Atlas-II Z8p HD PS SoM.

require atlas-z8.inc
```

## conf/machine/00131.conf
```bitbake
#@TYPE: Machine
#@NAME: 00131
#@DESCRIPTION: Machine support for iVeia 00131 (Atlas-II Z8 32p) SoM.

require atlas-z8.inc
```

## conf/machine/00133.conf
```bitbake
#@TYPE: Machine
#@NAME: 00133
#@DESCRIPTION: Machine support for iVeia 00133 (Atlas-II Z8 32p Custom) SoM.

require atlas-z8.inc
```

## conf/machine/00142.conf
```bitbake
#@TYPE: Machine
#@NAME: 00142
#@DESCRIPTION: Machine support for iVeia Helios Z7 PCIe SoM.

require helios-z7.inc
```

## conf/machine/00146.conf
```bitbake
#@TYPE: Machine
#@NAME: 00146
#@DESCRIPTION: Machine support for iVeia Atlas-III Z8 T2 SoM.

require atlas-z8.inc
```

## conf/machine/atlas-i-z7e.conf
```bitbake
#@TYPE: Machine
#@NAME: atlas-i-z7e
#@DESCRIPTION: Machine support for iVeia Atlas-I Z7e SoM.

require atlas-z7.inc
```

## conf/machine/atlas-i-z8.conf
```bitbake
#@TYPE: Machine
#@NAME: atlas-i-z8
#@DESCRIPTION: Machine support for iVeia Atlas-I Z8 SoM.

require atlas-z8.inc
```

## conf/machine/atlas-ii-z7x.conf
```bitbake
#@TYPE: Machine
#@NAME: atlas-ii-z7x
#@DESCRIPTION: Machine support for iVeia Atlas-II Z7x SoM.

require atlas-z7.inc
```

## conf/machine/atlas-ii-z8-9eg.conf
```bitbake
#@TYPE: Machine
#@NAME: atlas-ii-z8-9eg
#@DESCRIPTION: Machine support for iVeia Atlas-III Z8 SoM.

require atlas-z8.inc
```

## conf/machine/atlas-ii-z8-hp.conf
```bitbake
#@TYPE: Machine
#@NAME: atlas-ii-z8-hp
#@DESCRIPTION: Machine support for iVeia Atlas-II Z8 HP SoM.

require atlas-z8.inc
```

## conf/machine/atlas-ii-z8.conf
```bitbake
#@TYPE: Machine
#@NAME: atlas-ii-z8
#@DESCRIPTION: Machine support for iVeia Atlas-II Z8 SoM.

require atlas-z8.inc
```

## conf/machine/atlas-ii-z8ev.conf
```bitbake
#@TYPE: Machine
#@NAME: atlas-ii-z8-ev
#@DESCRIPTION: Machine support for iVeia Atlas-II Z8ev SoM.

require atlas-z8.inc
```

## conf/machine/atlas-ii-z8p-hd.conf
```bitbake
#@TYPE: Machine
#@NAME: atlas-ii-z8p-hd
#@DESCRIPTION: Machine support for iVeia Atlas-II Z8p HD PS SoM.

require atlas-z8.inc
```
