#include <machine/00172.dtsi>

&spi0 {
    tpm_tis@0 {
        compatible = "tcg,tpm_tis-spi";
        status = "okay";
        reg = <0>;
        spi-max-frequency = <500000>;
        /* TPM_PIRQ#   = MIO7 */
        /* TPM_SW_RST# = MIO8 */
    };
};
