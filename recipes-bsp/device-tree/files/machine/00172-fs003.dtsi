#include <machine/00172.dtsi>

/ {
    model = "Atlas-II Z8e";
    compatible = "iveia,00172-fs003", "iveia,00172", "iveia,atlas-z8", "xlnx,zynqmp";
};

&spi0 {
    tpm_tis@0 {
        compatible = "tcg,tpm_tis-spi";
        status = "okay";
        reg = <0>;
        spi-max-frequency = <500000>;
        /* TPM_PIRQ#   = MIO7 */
        /* TPM_SW_RST# = MIO8 */
    };
};
